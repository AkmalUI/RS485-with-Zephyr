## rs485_master/build/esp32_devkitc_wroom/esp32/procpu/Kconfig/Kconfig.shield
```kconfig
osource "C:\Users\ASUS\.zephyr_ide\external\zephyr/boards/shields/*/Kconfig.shield"
```

## rs485_master/build/esp32_devkitc_wroom/esp32/procpu/Kconfig/boards/Kconfig.defconfig
```kconfig
# Load Zephyr board defconfig descriptions.
osource "C:/Users/ASUS/.zephyr_ide/external/zephyr/boards/espressif/esp32_devkitc_wroom/Kconfig.defconfig"
```

## rs485_master/build/esp32_devkitc_wroom/esp32/procpu/Kconfig/boards/Kconfig.sysbuild
```kconfig
# Load Sysbuild board Kconfig descriptions.
osource "C:/Users/ASUS/.zephyr_ide/external/zephyr/boards/espressif/esp32_devkitc_wroom/Kconfig.sysbuild"
```

## rs485_master/build/stm32f746g_disco/Kconfig/boards/Kconfig.defconfig
```kconfig
# Load Zephyr board defconfig descriptions.
osource "C:/Users/ASUS/.zephyr_ide/external/zephyr/boards/st/stm32f746g_disco/Kconfig.defconfig"
```

## rs485_master/build/stm32f746g_disco/Kconfig/boards/Kconfig.stm32f746g_disco
```kconfig
# Load board Kconfig descriptions.
osource "C:/Users/ASUS/.zephyr_ide/external/zephyr/boards/st/stm32f746g_disco/Kconfig.stm32f746g_disco"
```

## rs485_slave/build/esp32_devkitc_wroom/esp32/procpu/Kconfig/arch/Kconfig
```kconfig
# Load Zephyr Arch Kconfig descriptions.
osource "C:/Users/ASUS/.zephyr_ide/external/zephyr/arch/x86/Kconfig"
osource "C:/Users/ASUS/.zephyr_ide/external/zephyr/arch/xtensa/Kconfig"
osource "C:/Users/ASUS/.zephyr_ide/external/zephyr/arch/sparc/Kconfig"
osource "C:/Users/ASUS/.zephyr_ide/external/zephyr/arch/riscv/Kconfig"
osource "C:/Users/ASUS/.zephyr_ide/external/zephyr/arch/posix/Kconfig"
osource "C:/Users/ASUS/.zephyr_ide/external/zephyr/arch/nios2/Kconfig"
osource "C:/Users/ASUS/.zephyr_ide/external/zephyr/arch/mips/Kconfig"
osource "C:/Users/ASUS/.zephyr_ide/external/zephyr/arch/arm64/Kconfig"
osource "C:/Users/ASUS/.zephyr_ide/external/zephyr/arch/arm/Kconfig"
osource "C:/Users/ASUS/.zephyr_ide/external/zephyr/arch/arc/Kconfig"
```

## rs485_slave/build/esp32_devkitc_wroom/esp32/procpu/Kconfig/boards/Kconfig.esp32_devkitc_wroom
```kconfig
# Load board Kconfig descriptions.
osource "C:/Users/ASUS/.zephyr_ide/external/zephyr/boards/espressif/esp32_devkitc_wroom/Kconfig.esp32_devkitc_wroom"
```

## rs485_slave/build/stm32f746g_disco/Kconfig/boards/Kconfig.sysbuild
```kconfig
# Load Sysbuild board Kconfig descriptions.
osource "C:/Users/ASUS/.zephyr_ide/external/zephyr/boards/st/stm32f746g_disco/Kconfig.sysbuild"
```
